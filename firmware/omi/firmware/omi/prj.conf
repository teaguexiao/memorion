## prj.conf
```kconfig
CONFIG_SERIAL=y

CONFIG_GPIO=y
CONFIG_INPUT=y
CONFIG_I2C=y
# CONFIG_I2C_SHELL=y
CONFIG_SPI=y
CONFIG_SPI_NOR=y
# CONFIG_SPI_SHELL=y
CONFIG_SETTINGS=y
CONFIG_SETTINGS_NVS=y
CONFIG_NVS=y

CONFIG_PM_DEVICE=y
# CONFIG_PM_DEVICE_RUNTIME=y
CONFIG_ADC=y
CONFIG_ADC_ASYNC=y
CONFIG_ADC_NRFX_SAADC=y
CONFIG_AUDIO=y
CONFIG_AUDIO_DMIC=y
CONFIG_FLASH=y
CONFIG_FLASH_JESD216_API=y
CONFIG_DISK_DRIVER_SDMMC=y
CONFIG_SENSOR=y
CONFIG_REGULATOR=y
CONFIG_ENTROPY_GENERATOR=y

CONFIG_BT=y
CONFIG_BT_SMP=y
CONFIG_BT_PERIPHERAL=y
CONFIG_BT_DIS=n
CONFIG_BT_BAS=n
# CONFIG_BT_DEVICE_NAME="OMI" # configurated bellow
# CONFIG_BT_DEVICE_APPEARANCE=768 # TODO: conflict
CONFIG_CBPRINTF_FP_SUPPORT=y

CONFIG_NCS_SAMPLE_MCUMGR_BT_OTA_DFU=y
CONFIG_MCUMGR_GRP_IMG_ALLOW_ERASE_PENDING=y
# Enable the BT NUS shell
# CONFIG_SHELL=y
# CONFIG_SHELL_BT_NUS=y
# CONFIG_SHELL_BT_NUS_LOG_LEVEL_DBG=y
# CONFIG_SHELL_BACKEND_DUMMY=y

CONFIG_POWEROFF=y

# CONFIG_T5838_LOG_LEVEL_DBG=y
# CONFIG_T5838_AAD_TRIGGER=y

# file system
# CONFIG_MAIN_STACK_SIZE=2048
CONFIG_FILE_SYSTEM=y
# CONFIG_FILE_SYSTEM_EXT2=y

# Enable to allow formatting
CONFIG_FILE_SYSTEM_MKFS=y
CONFIG_FS_FATFS_MKFS=y
# CONFIG_TEST_RANDOM_GENERATOR=y

CONFIG_DISK_ACCESS=y
CONFIG_DISK_DRIVER_SDMMC=y

# FAT filesystem automatically detects partitions
# CONFIG_EXT2_DISK_STARTING_SECTOR=2082

# wifi
CONFIG_WIFI=y
CONFIG_WIFI_NRF70=y
CONFIG_WIFI_FIXED_MAC_ADDRESS="14:5A:FC:5E:37:9C"
# WPA supplicant
CONFIG_WIFI_NM_WPA_SUPPLICANT=y
CONFIG_WIFI_READY_LIB=y

# Soft AP
CONFIG_NRF70_AP_MODE=y
CONFIG_WIFI_NM_WPA_SUPPLICANT_AP=y
CONFIG_WIFI_NM_WPA_SUPPLICANT_LOG_LEVEL_INF=y

# Networking
CONFIG_NETWORKING=y
CONFIG_NET_SOCKETS=y
CONFIG_NET_IPV4=y
CONFIG_NET_IPV6=n
CONFIG_NET_UDP=y
CONFIG_NET_TCP=y
CONFIG_NET_DHCPV4_SERVER=y

CONFIG_NET_PKT_TX_COUNT=32
CONFIG_NET_PKT_RX_COUNT=10
CONFIG_NET_BUF_TX_COUNT=64
CONFIG_NET_BUF_RX_COUNT=10

CONFIG_HEAP_MEM_POOL_SIZE=175000
CONFIG_HEAP_MEM_POOL_IGNORE_MIN=y
CONFIG_NET_TC_TX_COUNT=1

CONFIG_NET_IF_UNICAST_IPV4_ADDR_COUNT=1
CONFIG_NET_MAX_CONTEXTS=8
CONFIG_NET_MAX_CONN=8
CONFIG_NET_CONTEXT_SYNC_RECV=y

CONFIG_INIT_STACKS=y

CONFIG_NET_L2_ETHERNET=y

CONFIG_NET_CONFIG_SETTINGS=y
CONFIG_NET_CONFIG_INIT_TIMEOUT=0
CONFIG_NET_PKT_BUF_TX_DATA_POOL_SIZE=12000

# Memories
CONFIG_MAIN_STACK_SIZE=4096
CONFIG_NET_TX_STACK_SIZE=2048
CONFIG_NET_RX_STACK_SIZE=2048

# Kernel options
CONFIG_ENTROPY_GENERATOR=y
CONFIG_POSIX_CLOCK=y

CONFIG_NET_CONFIG_MY_IPV4_ADDR="192.168.1.1"
CONFIG_NET_CONFIG_MY_IPV4_NETMASK="255.255.255.0"
CONFIG_NET_CONFIG_MY_IPV4_GW="192.168.1.1"
CONFIG_NET_MGMT_EVENT_QUEUE_TIMEOUT=5000

#
# Hardware settings
#

CONFIG_PWM=n
CONFIG_GPIO=y
CONFIG_ADC=y

#
# Audio (new)
#
CONFIG_I2S=y
CONFIG_I2S_NRFX=y
CONFIG_SPI_NRFX=y
CONFIG_AUDIO=y
CONFIG_AUDIO_DMIC=y
CONFIG_AUDIO_DMIC_NRFX_PDM=y
CONFIG_NRFX_PDM0=y  # PDM microphone

# Watchdog Timer
CONFIG_WATCHDOG=y
CONFIG_WDT_DISABLE_AT_BOOT=n

# To flash via dev board
#CONFIG_BUILD_OUTPUT_UF2=n
#CONFIG_USE_DT_CODE_PARTITION=n

#
# Bluetooth settings
#

CONFIG_BT=y
CONFIG_BT_PERIPHERAL=y
CONFIG_BT_MAX_CONN=1
# CONFIG_BT_EXT_ADV_MAX_ADV_SET=2
CONFIG_BT_MAX_PAIRED=1
CONFIG_BT_DEVICE_APPEARANCE=22
CONFIG_BT_GATT_DYNAMIC_DB=y

#
# Max transmit power supported by nRF52840
#

CONFIG_BT_CTLR_TX_PWR_ANTENNA=8
CONFIG_BT_PHY_UPDATE=y

#
# Battery and Device Information services
#

CONFIG_BT_BAS=y
CONFIG_BT_DIS=y
CONFIG_BT_DIS_PNP=n
CONFIG_BT_DEVICE_NAME="Omi"
CONFIG_BT_DIS_MODEL="Omi CV 1"
CONFIG_BT_DIS_MANUF="Based Hardware"
CONFIG_BT_DIS_FW_REV=y
CONFIG_BT_DIS_HW_REV=y
CONFIG_BT_DIS_FW_REV_STR="3.0.15"
CONFIG_BT_DIS_HW_REV_STR="5.0"

#
# Large BLE packets / BLE Buffers 
#
# CONFIG_BT_GATT_CLIENT=y
# CONFIG_BT_THROUGHPUT=y

CONFIG_BT_L2CAP_TX_MTU=498

CONFIG_BT_CTLR_DATA_LENGTH_MAX=251
CONFIG_BT_CTLR_PHY_2M=y
CONFIG_BT_CTLR_PHY_CODED=y
CONFIG_BT_CTLR_SDC_MAX_CONN_EVENT_LEN_DEFAULT=400000
CONFIG_BT_CONN_TX_MAX=20
CONFIG_BT_L2CAP_TX_BUF_COUNT=10
CONFIG_BT_BUF_ACL_RX_SIZE=1024
CONFIG_BT_BUF_ACL_TX_SIZE=2048
# CONFIG_BT_ATT_TX_COUNT=10
# CONFIG_BT_EXT_ADV=y
# CONFIG_BT_PER_ADV=y
# CONFIG_BT_OBSERVER=y
# CONFIG_BT_ATT_PREPARE_COUNT=2
CONFIG_BT_USER_DATA_LEN_UPDATE=y
CONFIG_BT_USER_PHY_UPDATE=y
CONFIG_BT_AUTO_DATA_LEN_UPDATE=y
CONFIG_BT_AUTO_PHY_UPDATE=y
#CONFIG_BT_GATT_AUTO_UPDATE_MTU=y

CONFIG_BT_GATT_CLIENT=y

# Automatically request preferred connection parameters (default is y, but explicit)
CONFIG_BT_GAP_AUTO_UPDATE_CONN_PARAMS=y

# Set preferred connection parameters
# 7.5ms
CONFIG_BT_PERIPHERAL_PREF_MIN_INT=6
# 30ms
CONFIG_BT_PERIPHERAL_PREF_MAX_INT=24
CONFIG_BT_PERIPHERAL_PREF_LATENCY=0
# 4 seconds
CONFIG_BT_PERIPHERAL_PREF_TIMEOUT=400

CONFIG_FPU=y
CONFIG_NORDIC_QSPI_NOR=y
# CONFIG_BOARD_ENABLE_DCDC=y
#

#
# Console
#
# Y to enable console log
CONFIG_CONSOLE=n
CONFIG_PRINTK=n
CONFIG_UART_CONSOLE=n
# CONFIG_SHELL_BACKEND_SERIAL=y

#
# Logs
#

## Enable the lines below to enable logs via UART/USB
# CONFIG_LOG=y
# CONFIG_NET_LOG=y
# CONFIG_LOG_PRINTK=y
# CONFIG_UART_CONSOLE=y
# CONFIG_LOG_PROCESS_THREAD_PRIORITY=5
# CONFIG_LOG_PROCESS_THREAD_CUSTOM_PRIORITY=y
#
# CONFIG_LOG_MODE_IMMEDIATE=y
# CONFIG_SENSOR_LOG_LEVEL_DBG=y
# CONFIG_FLASH_LOG_LEVEL_DBG=y
# CONFIG_FS_LOG_LEVEL_DBG=y
# CONFIG_WIFI_LOG_LEVEL_ERR=y
# CONFIG_WIFI_NRF70_LOG_LEVEL_DBG=y

#
# Enable logging (set level to DBG=4, INF=3, WRN=2, ERR=1)
# CONFIG_LOG_DEFAULT_LEVEL=3

#
# Log level and buffer size
#

# CONFIG_LOG_OVERRIDE_LEVEL=4
# CONFIG_LOG_BUFFER_SIZE=32000
# CONFIG_LOG_PROCESS_THREAD_STACK_SIZE=4096

#
# Debug
#

# CONFIG_DEBUG=y
# CONFIG_DEBUG_OPTIMIZATIONS=y
# CONFIG_SERIAL=y

#
# Debug (This value breaks some builds)
#

# CONFIG_ASSERT=y

#
# BT log configuration
#

# CONFIG_BT_DEBUG_LOG=y
# CONFIG_BT_L2CAP_LOG_LEVEL_DBG=y
# CONFIG_BT_LOG_LEVEL_DBG=y

# CONFIG_BT_RX_STACK_SIZE=4096
# CONFIG_BT_CTLR_RX_PRIO_STACK_SIZE=4096
# CONFIG_BT_DEBUG_LOG=y
# CONFIG_BT_RX_STACK_SIZE=4096
# CONFIG_BT_CTLR_RX_PRIO_STACK_SIZE=4096

#
# SD Card Support (all devices required)
#

CONFIG_DISK_ACCESS=y
CONFIG_FILE_SYSTEM=y

# WARN: was the cause of high battery usage. Need to be checked.
CONFIG_FAT_FILESYSTEM_ELM=y

CONFIG_FS_FATFS_MOUNT_MKFS=y
#CONFIG_FS_FATFS_EXFAT=y
CONFIG_MAIN_STACK_SIZE=4096
# CONFIG_DISK_DRIVER_SDMMC=y
# CONFIG_SPI=y
# CONFIG_HEAP_MEM_POOL_SIZE=512 # disabled by conflicting

#
# Disable unused peripherals
#
CONFIG_I2C=n
# CONFIG_NRFX_TWIM0=n
# CONFIG_NRFX_TWIM1=n

#
# LSM6DSL sensor (accelerometer and gyroscope)
#
CONFIG_LSM6DSL=y
CONFIG_LSM6DSL_ENABLE_TEMP=n
# CONFIG_LSM6DSL_TRIGGER_GLOBAL_THREAD=y
CONFIG_SENSOR=y

#
# Speaker
#
CONFIG_I2S=y
CONFIG_I2S_NRFX=y
CONFIG_SPI_NRFX=y

#
# NFC (in the future)
#

# CONFIG_NFC_T2T_NRFXLIB=y
# CONFIG_NFC_NDEF=y
# CONFIG_NFC_NDEF_MSG=y
# CONFIG_NFC_NDEF_RECORD=y
# CONFIG_NFC_NDEF_URI_MSG=y
# CONFIG_NFC_NDEF_URI_REC=y
# CONFIG_HWINFO=y

#
#EVERYTHING ELSE
#

CONFIG_RING_BUFFER=y

CONFIG_PM_DEVICE=y
# CONFIG_NRFX_USBD=y

# CONFIG_FLASH=y
#

#
# Omi features configuration
#
CONFIG_OMI_CODEC_OPUS=y
CONFIG_OMI_ENABLE_OFFLINE_STORAGE=y
CONFIG_OMI_ENABLE_ACCELEROMETER=n
CONFIG_OMI_ENABLE_BUTTON=y
CONFIG_OMI_ENABLE_SPEAKER=n
CONFIG_OMI_ENABLE_BATTERY=y
CONFIG_OMI_ENABLE_USB=n
CONFIG_OMI_ENABLE_HAPTIC=y
CONFIG_OMI_ENABLE_RFSW_CTRL=y
CONFIG_OMI_ENABLE_MONITOR=n
CONFIG_OMI_ENABLE_WIFI=y
```

## src/main.c
```c
#include <zephyr/kernel.h>
#include <zephyr/logging/log.h>
#include <zephyr/pm/device_runtime.h>
#include <zephyr/shell/shell.h>

#include "lib/core/button.h"
#include "lib/core/codec.h"
#include "lib/core/config.h"
#include "lib/core/feedback.h"
#include "lib/core/haptic.h"
#include "lib/core/led.h"
#include "lib/core/lib/battery/battery.h"
#include "lib/core/mic.h"
#ifdef CONFIG_OMI_ENABLE_MONITOR
#include "lib/core/monitor.h"
#endif
#include "lib/core/settings.h"
#include "lib/core/transport.h"
#ifdef CONFIG_OMI_ENABLE_OFFLINE_STORAGE
#include "lib/core/storage.h"
#endif
#include <hal/nrf_reset.h>

#include "lib/core/sd_card.h"
#include "spi_flash.h"
#include "wdog_facade.h"

LOG_MODULE_REGISTER(main, CONFIG_LOG_DEFAULT_LEVEL);

#ifdef CONFIG_OMI_ENABLE_BATTERY
#define BATTERY_FULL_THRESHOLD_PERCENT 98 // 98%
extern uint8_t battery_percentage;
#endif
bool is_connected = false;
bool is_charging = false;
bool is_off = false;
bool blink_toggle = false;

static uint8_t disconnect_blink_counter = 0;
#define DISCONNECT_BLINK_PERIOD 2

static uint8_t connected_blink_counter = 0;
#define CONNECTED_BLINK_PERIOD 3

#define LED_FLASH_DURATION_MS 200

static void print_reset_reason(void)
{
    uint32_t reas;

    reas = nrf_reset_resetreas_get(NRF_RESET);
    nrf_reset_resetreas_clear(NRF_RESET, reas);

    if (reas & NRF_RESET_RESETREAS_DOG0_MASK) {
        printk("Reset by WATCHDOG\n");
    } else if (reas & NRF_RESET_RESETREAS_NFC_MASK) {
        printk("Wake up by NFC field detect\n");
    } else if (reas & NRF_RESET_RESETREAS_RESETPIN_MASK) {
        printk("Reset by pin-reset\n");
    } else if (reas & NRF_RESET_RESETREAS_SREQ_MASK) {
        printk("Reset by soft-reset\n");
    } else if (reas & NRF_RESET_RESETREAS_LOCKUP_MASK) {
        printk("Reset by CPU LOCKUP\n");
    } else if (reas) {
        printk("Reset by a different source (0x%08X)\n", reas);
    } else {
        printk("Power-on-reset\n");
    }
}

static void codec_handler(uint8_t *data, size_t len)
{
#ifdef CONFIG_OMI_ENABLE_MONITOR
    monitor_inc_broadcast_audio();
#endif
    int err = broadcast_audio_packets(data, len);
    if (err) {
#ifdef CONFIG_OMI_ENABLE_MONITOR
        monitor_inc_broadcast_audio_failed();
#endif
    }
}

static void mic_handler(int16_t *buffer)
{
#ifdef CONFIG_OMI_ENABLE_MONITOR
    // Track total bytes processed (each sample is 2 bytes)
    monitor_inc_mic_buffer();
#endif

    int err = codec_receive_pcm(buffer, MIC_BUFFER_SAMPLES);
    if (err) {
        LOG_ERR("Failed to process PCM data: %d", err);
    }
}

static void boot_led_sequence(void)
{
    // Quick blue pulse = "I'm alive, booting..."
    set_led_blue(true);
    k_msleep(300);
    led_off();
}

static void boot_ready_sequence(void)
{
    // 3x green blink = "Ready!"
    for (int i = 0; i < 3; i++) {
        set_led_green(true);
        k_msleep(200);
        set_led_green(false);
        k_msleep(200);
    }
    led_off();
    k_msleep(10);
}

void set_led_state()
{
    // If device is off, turn off all LEDs immediately
    if (is_off) {
        led_off();
        return;
    }

    bool green = false;
    bool blue = false;
    bool red = false;

    if (is_charging) {
#ifdef CONFIG_OMI_ENABLE_BATTERY
        // Solid green if battery is full (>= BATTERY_FULL_THRESHOLD_PERCENT)
        if (battery_percentage >= BATTERY_FULL_THRESHOLD_PERCENT) {
            green = true;
        } else
#endif
        {
            green = blink_toggle;
            blue = !blink_toggle && is_connected;
            red = !blink_toggle && !is_connected;
            blink_toggle = !blink_toggle;
        }
    } else if (is_connected) {
        disconnect_blink_counter = 0;
        set_led_green(false);
        set_led_red(false);
        if (connected_blink_counter == 0) {
            set_led_blue(true);
            k_msleep(LED_FLASH_DURATION_MS);
            set_led_blue(false);
        }
        connected_blink_counter = (connected_blink_counter + 1) % CONNECTED_BLINK_PERIOD;
        return;
    } else {
        connected_blink_counter = 0;
        set_led_green(false);
        set_led_blue(false);
        if (disconnect_blink_counter == 0) {
            set_led_red(true);
            k_msleep(LED_FLASH_DURATION_MS);
            set_led_red(false);
        }
        disconnect_blink_counter = (disconnect_blink_counter + 1) % DISCONNECT_BLINK_PERIOD;
        return;
    }

    set_led_green(green);
    set_led_blue(blue);
    set_led_red(red);
}

static int suspend_unused_modules(void)
{
    int err = flash_off();
    if (err) {
        LOG_ERR("Can not suspend the spi flash module: %d", err);
    }

    return 0;
}

int main(void)
{
    int ret;
    printk("Starting omi ...\n");

    // print reset reason at startup
    print_reset_reason();

    // Initialize watchdog first to catch any early freezes
    ret = watchdog_init();
    if (ret) {
        LOG_WRN("Watchdog init failed (err %d), continuing without watchdog", ret);
    }

    // Initialize Haptic driver first; this is building up for future of omi turn on sequence - long press to turn on
    // instead of short press
#ifdef CONFIG_OMI_ENABLE_HAPTIC
    ret = haptic_init();
    if (ret) {
        LOG_ERR("Failed to initialize Haptic driver (err %d)", ret);
        error_haptic();
        // Non-critical, continue boot
    } else {
        LOG_INF("Haptic driver initialized");
        play_haptic_milli(100);
    }
#endif

    // Initialize LEDs
    LOG_INF("Initializing LEDs...\n");

    ret = led_start();
    if (ret) {
        LOG_ERR("Failed to initialize LEDs (err %d)", ret);
        error_led_driver();
        return ret;
    }

    // Suspend unused modules
    LOG_PRINTK("\n");
    LOG_INF("Suspending unused modules...\n");
    ret = suspend_unused_modules();
    if (ret) {
        LOG_ERR("Failed to suspend unused modules (err %d)", ret);
        ret = 0;
    }

    // Initialize settings
    LOG_INF("Initializing settings...\n");
    int setting_ret = app_settings_init();
    if (setting_ret) {
        LOG_ERR("Failed to initialize settings (err %d)", setting_ret);
    }

#ifdef CONFIG_OMI_ENABLE_MONITOR
    // Initialize monitoring system
    LOG_INF("Initializing monitoring system...\n");
    ret = monitor_init();
    if (ret) {
        LOG_ERR("Failed to initialize monitoring system (err %d)", ret);
    }
#endif

    if (setting_ret) {
        error_settings();
        app_settings_save_dim_ratio(30);
    }

    // Initialize battery
#ifdef CONFIG_OMI_ENABLE_BATTERY
    ret = battery_init();
    if (ret) {
        LOG_ERR("Battery init failed (err %d)", ret);
        error_battery_init();
        return ret;
    }

    ret = battery_charge_start();
    if (ret) {
        LOG_ERR("Battery failed to start (err %d)", ret);
        error_battery_charge();
        return ret;
    }
    LOG_INF("Battery initialized");
#endif

    // Initialize button
#ifdef CONFIG_OMI_ENABLE_BUTTON
    ret = button_init();
    if (ret) {
        LOG_ERR("Failed to initialize Button (err %d)", ret);
        error_button();
        return ret;
    }
    LOG_INF("Button initialized");
    activate_button_work();
#endif

    // SD Card
    ret = app_sd_init();
    if (ret) {
        LOG_ERR("Failed to initialize SD Card (err %d)", ret);
        error_sd_card();
        return ret;
    }

#ifdef CONFIG_OMI_ENABLE_OFFLINE_STORAGE
    // Initialize storage service for offline audio
    ret = storage_init();
    if (ret) {
        LOG_ERR("Failed to initialize storage service (err %d)", ret);
        error_storage();
        // Non-critical, continue boot
    } else {
        LOG_INF("Storage service initialized");
    }
#endif

    // Indicate transport initialization
    LOG_PRINTK("\n");
    LOG_INF("Initializing transport...\n");

    // Start transport
    int transportErr;
    transportErr = transport_start();
    if (transportErr) {
        LOG_ERR("Failed to start transport (err %d)", transportErr);
        error_transport();
        return transportErr;
    }

    // Initialize codec
    LOG_INF("Initializing codec...\n");

    // Set codec callback
    set_codec_callback(codec_handler);
    ret = codec_start();
    if (ret) {
        LOG_ERR("Failed to start codec: %d", ret);
        error_codec();
        return ret;
    }

    // Initialize microphone
    LOG_INF("Initializing microphone...\n");
    set_mic_callback(mic_handler);
    ret = mic_start();
    if (ret) {
        LOG_ERR("Failed to start microphone: %d", ret);
        error_microphone();
        return ret;
    }
#ifdef CONFIG_OMI_ENABLE_WIFI
    // Initialize wifi
    wifi_init();
#endif
    LOG_INF("Device initialized successfully\n");

    while (1) {
        watchdog_feed();
#ifdef CONFIG_OMI_ENABLE_MONITOR
        monitor_log_metrics();
#endif

        set_led_state();
        transport_check_connection_health();

        k_msleep(is_connected ? 1000 : 5000);
    }

    printk("Exiting omi...");
    return 0;
}
```

## src/battery.c
```c
#include "lib/core/lib/battery/battery.h"

#include <hal/nrf_saadc.h>
#include <zephyr/device.h>
#include <zephyr/devicetree.h>
#include <zephyr/drivers/adc.h>
#include <zephyr/drivers/gpio.h>
#include <zephyr/dt-bindings/gpio/nordic-nrf-gpio.h>
#include <zephyr/kernel.h>
#include <zephyr/logging/log.h>

LOG_MODULE_REGISTER(battery, CONFIG_LOG_DEFAULT_LEVEL);

#define DISCHARGE_STATES_COUNT 22
#define CHARGING_STATES_COUNT 23

#define ADC_TOTAL_SAMPLES 50
// +1 for the calibration sample
int16_t sample_buffer[ADC_TOTAL_SAMPLES + 1];

#define ADC_RESOLUTION 12
#define ADC_GAIN ADC_GAIN_1_3
#define ADC_REFERENCE ADC_REF_INTERNAL
#define ADC_ACQUISITION_TIME ADC_ACQ_TIME(ADC_ACQ_TIME_MICROSECONDS, 10)
#define ADC_1ST_CHANNEL_ID 0
#define ADC_1ST_CHANNEL_INPUT NRF_SAADC_INPUT_AIN0

// EMA filter: N=18, alpha = 65535/(18+1) ~= 3449 (~5.3%)
#define BATTERY_FILTER_ALPHA_U16 (uint16_t)(65535/(18+1))
#define FILTER_INIT_CYCLES 8

// Charging state transition smoothing
#define CHARGE_TRANSITION_TICKS 6  // ~60s at 10s interval before fully switching tables
#define MAX_BATTERY_DELTA_PER_TICK 2  // Max percentage change per measurement cycle

// Static variable to store previous EMA value for battery percentage
static uint8_t battery_percentage_ema = 0;
static bool ema_initialized = false;
static bool is_first_measurement = true;
static uint8_t ema_init_counter = 0;

// Charging state transition tracking
static bool prev_is_charging = false;
static bool charge_state_changed = false;
static uint8_t transition_counter = 0;
static uint8_t transition_anchor_pct = 0;

static const struct device *const adc_dev = DEVICE_DT_GET(DT_NODELABEL(adc));
static const struct gpio_dt_spec power_pin = GPIO_DT_SPEC_GET_OR(DT_NODELABEL(power_pin), gpios, {0});
static const struct gpio_dt_spec bat_read_pin = GPIO_DT_SPEC_GET_OR(DT_NODELABEL(bat_read_pin), gpios, {0});
static const struct gpio_dt_spec bat_chg_pin = GPIO_DT_SPEC_GET_OR(DT_NODELABEL(bat_chg_pin), gpios, {0});

static struct gpio_callback bat_chg_cb;

static K_MUTEX_DEFINE(battery_mut);

// 150mAh LiPo battery discharge profile (measured under ~5mA typical load)
// Dense sampling in the 3.7V~3.95V flat region for better mid-range accuracy
typedef struct {
    uint16_t millivolts;
    uint8_t percentage;
} BatteryState;

BatteryState battery_discharge_states[DISCHARGE_STATES_COUNT] = {
    {4140, 100},
    {4120, 97},
    {4100, 94},
    {4070, 88},
    {4040, 82},
    {4010, 76},
    {3980, 70},
    {3955, 65},
    {3935, 60},
    {3910, 55},
    {3890, 50},
    {3870, 45},
    {3845, 40},
    {3820, 35},
    {3790, 30},
    {3760, 25},
    {3730, 20},
    {3700, 15},
    {3670, 10},
    {3630, 5},
    {3500, 1},
    {   0, 0},
};

// Charging profile: independently measured during CC/CV charge cycle
// Voltage is higher than discharge at same SOC due to IR drop + charge overpotential
BatteryState battery_charging_states[CHARGING_STATES_COUNT] = {
    {4200, 100},
    {4190, 97},
    {4175, 94},
    {4155, 88},
    {4130, 82},
    {4105, 76},
    {4080, 70},
    {4055, 65},
    {4030, 60},
    {4005, 55},
    {3985, 50},
    {3965, 45},
    {3940, 40},
    {3920, 35},
    {3895, 30},
    {3870, 25},
    {3840, 20},
    {3810, 15},
    {3780, 10},
    {3750, 5},
    {3700, 3},
    {3650, 1},
    {   0, 0},
};

extern bool is_charging;

static const struct adc_channel_cfg m_1st_channel_cfg = {
    .gain = ADC_GAIN,
    .reference = ADC_REFERENCE,
    .acquisition_time = ADC_ACQUISITION_TIME,
    .channel_id = ADC_1ST_CHANNEL_ID,
#if defined(CONFIG_ADC_CONFIGURABLE_INPUTS)
    .input_positive = ADC_1ST_CHANNEL_INPUT,
#endif
};

// Define ADC sequence for this read operation
const struct adc_sequence_options sequence_opts = {
    .extra_samplings = ADC_TOTAL_SAMPLES,
    .interval_us = 0,
    .callback = NULL,
    .user_data = NULL,
};

struct adc_sequence sequence = {
    .options = &sequence_opts,
    .channels = BIT(ADC_1ST_CHANNEL_ID),
    .buffer = sample_buffer,
    .buffer_size = sizeof(sample_buffer),
    .resolution = ADC_RESOLUTION,
};

uint8_t update_ema_filter(uint32_t current_ema, uint8_t new_value)
{
    // At extremes, use slow ±1 stepping to avoid oscillation
    if ((!is_charging && (current_ema <= 5)) || (is_charging && (current_ema >= 95))) {
        if (is_charging) {
            return (new_value > current_ema) ? current_ema + 1 : current_ema;
        } else {
            return (new_value < current_ema) ? current_ema - 1 : current_ema;
        }
    }

    const uint32_t alpha = BATTERY_FILTER_ALPHA_U16;
    const uint32_t alpha_complement = UINT16_MAX - BATTERY_FILTER_ALPHA_U16;

    uint64_t new_ema = (alpha * new_value) + (alpha_complement * current_ema);

    return (uint8_t)((new_ema + 32768) >> 16);
}

static void battery_charging_callback(const struct device *dev, struct gpio_callback *cb, uint32_t pins)
{
    int err = battery_charging_state_read();
    if (err) {
        LOG_ERR("Failed to read charging state (%d)", err);
    }
}

// Dynamic charging voltage compensation
// CC phase (lower voltage): larger IR drop compensation
// CV phase (near 4.2V): minimal compensation needed
static int16_t get_charging_compensation(int32_t adc_mv)
{
    int32_t approx_vbat = adc_mv * 3;

    if (approx_vbat < 3700) {
        // Deep discharge CC phase — very high IR drop + overpotential
        return 45;
    } else if (approx_vbat < 3900) {
        // Normal CC phase
        return 35;
    } else if (approx_vbat < 4050) {
        // CC to CV transition
        return 18;
    } else {
        // CV phase, current tapering
        return 10;
    }
}

static uint8_t lookup_percentage(BatteryState *states, int count, uint16_t battery_millivolt)
{
    if (battery_millivolt >= states[0].millivolts) {
        return states[0].percentage;
    }
    if (battery_millivolt <= states[count - 1].millivolts) {
        return states[count - 1].percentage;
    }

    for (int i = 0; i < count - 1; i++) {
        if (battery_millivolt <= states[i].millivolts && battery_millivolt > states[i + 1].millivolts) {
            uint16_t voltage_range = states[i].millivolts - states[i + 1].millivolts;
            uint8_t percentage_range = states[i].percentage - states[i + 1].percentage;
            uint16_t voltage_diff = states[i].millivolts - battery_millivolt;

            return states[i].percentage - (voltage_diff * percentage_range) / voltage_range;
        }
    }

    return 0;
}

int battery_get_millivolt(uint16_t *battery_millivolt)
{
    int err;

    // Voltage divider circuit
    // based on practical measurements adjusted on the omi device
    const uint16_t R1 = 1091;
    const uint16_t R2 = 499;

    k_mutex_lock(&battery_mut, K_FOREVER);

    err = gpio_pin_configure_dt(&bat_read_pin, GPIO_OUTPUT | NRF_GPIO_DRIVE_S0H1);
    if (err < 0) {
        LOG_ERR("Failed to configure bat_read_pin to output: %d", err);
        k_mutex_unlock(&battery_mut);
        return err;
    }

    // Set pin low to enable battery voltage measurement path
    gpio_pin_set(bat_read_pin.port, bat_read_pin.pin, 0);

    if (!device_is_ready(adc_dev)) {
        LOG_ERR("ADC device %s is not ready", adc_dev->name);
        gpio_pin_configure_dt(&bat_read_pin, GPIO_INPUT); // Restore pin state
        k_mutex_unlock(&battery_mut);
        return -ENODEV;
    }

    err = adc_channel_setup(adc_dev, &m_1st_channel_cfg);
    if (err) {
        LOG_ERR("ADC channel setup failed (error %d)", err);
        gpio_pin_configure_dt(&bat_read_pin, GPIO_INPUT); // Restore pin state
        k_mutex_unlock(&battery_mut);
        return err;
    }

    // Trigger offset calibration. The first sample after this will be affected.
    NRF_SAADC_S->TASKS_CALIBRATEOFFSET = 1;
    k_busy_wait(100); // Short delay for calibration, if needed.

    err = adc_read(adc_dev, &sequence);
    if (err) {
        LOG_WRN("ADC read failed (error %d)", err);
        gpio_pin_configure_dt(&bat_read_pin, GPIO_INPUT); // Restore pin state
        k_mutex_unlock(&battery_mut);
        return err;
    }

    // Calculate median of valid samples, discarding the first one (post-calibration)
    // Copy samples to a temporary array for sorting
    int16_t sorted_samples[ADC_TOTAL_SAMPLES];
    for (int i = 0; i < ADC_TOTAL_SAMPLES; i++) {
        sorted_samples[i] = sample_buffer[i + 1];
    }

    // Simple bubble sort for median calculation
    for (int i = 0; i < ADC_TOTAL_SAMPLES - 1; i++) {
        for (int j = 0; j < ADC_TOTAL_SAMPLES - i - 1; j++) {
            if (sorted_samples[j] > sorted_samples[j + 1]) {
                int16_t temp = sorted_samples[j];
                sorted_samples[j] = sorted_samples[j + 1];
                sorted_samples[j + 1] = temp;
            }
        }
    }

    // Calculate median
    int32_t adc_raw_val;
    if (ADC_TOTAL_SAMPLES % 2 == 0) {
        adc_raw_val = (sorted_samples[ADC_TOTAL_SAMPLES / 2 - 1] + sorted_samples[ADC_TOTAL_SAMPLES / 2]) / 2;
    } else {
        adc_raw_val = sorted_samples[ADC_TOTAL_SAMPLES / 2];
    }

    LOG_INF("Median ADC raw (after discarding 1st of %d total): %d", ADC_TOTAL_SAMPLES + 1, adc_raw_val);

    // Convert median ADC value to millivolts at the ADC pin
    uint16_t adc_vref_mv = adc_ref_internal(adc_dev);
    err = adc_raw_to_millivolts(adc_vref_mv, ADC_GAIN, ADC_RESOLUTION, &adc_raw_val);
    if (err) {
        LOG_WRN("ADC raw to millivolts conversion failed (error %d)", err);
        gpio_pin_configure_dt(&bat_read_pin, GPIO_INPUT); // Restore pin state
        k_mutex_unlock(&battery_mut);
        return err;
    }
    LOG_INF("ADC mV at pin (after conversion): %d, charging: %s", adc_raw_val, is_charging ? "true" : "false");

    // Dynamic charging compensation based on charge phase (CC vs CV)
    if (is_charging) {
        adc_raw_val -= get_charging_compensation(adc_raw_val);
    }

    // Calculate battery voltage using the voltage divider formula
    *battery_millivolt = (uint16_t) (adc_raw_val * ((float) (R1 + R2) / R2));
    LOG_INF("Battery voltage (mV): %d", *battery_millivolt);

    // Restore bat_read_pin to INPUT state to save power/avoid affecting other circuits
    err = gpio_pin_configure_dt(&bat_read_pin, GPIO_INPUT);
    if (err < 0) {
        LOG_ERR("Failed to configure bat_read_pin to input: %d", err);
        k_mutex_unlock(&battery_mut);
        return err;
    }

    if (is_first_measurement) {
        LOG_INF("First measurement, skipping to allow voltage to stabilize");
        is_first_measurement = false;
        k_mutex_unlock(&battery_mut);
        return -EAGAIN; // Skip first measurement to allow voltage to stabilize
    }

    k_mutex_unlock(&battery_mut);

    return 0;
}

int battery_get_percentage(uint8_t *battery_percentage, uint16_t battery_millivolt)
{
    uint8_t raw_percentage = 0;

    // Detect charging state change and start transition period
    if (ema_initialized && is_charging != prev_is_charging) {
        charge_state_changed = true;
        transition_counter = 0;
        transition_anchor_pct = battery_percentage_ema;
        prev_is_charging = is_charging;
        LOG_INF("Charge state changed, anchoring at %d%%, starting transition", transition_anchor_pct);
    }

    // During transition: blend between anchor and new table's value
    if (charge_state_changed) {
        uint8_t new_table_pct;
        if (is_charging) {
            new_table_pct = lookup_percentage(battery_charging_states, CHARGING_STATES_COUNT, battery_millivolt);
        } else {
            new_table_pct = lookup_percentage(battery_discharge_states, DISCHARGE_STATES_COUNT, battery_millivolt);
        }

        transition_counter++;
        if (transition_counter >= CHARGE_TRANSITION_TICKS) {
            // Transition complete, use new table fully
            charge_state_changed = false;
            raw_percentage = new_table_pct;
            LOG_INF("Charge transition complete, now at %d%%", raw_percentage);
        } else {
            // Linear blend: weight shifts from anchor toward new table value
            uint8_t weight = (transition_counter * 100) / CHARGE_TRANSITION_TICKS;
            raw_percentage = (uint8_t)(((100 - weight) * transition_anchor_pct + weight * new_table_pct) / 100);
        }
    } else {
        // Normal operation: use appropriate table
        if (is_charging) {
            raw_percentage = lookup_percentage(battery_charging_states, CHARGING_STATES_COUNT, battery_millivolt);
        } else {
            raw_percentage = lookup_percentage(battery_discharge_states, DISCHARGE_STATES_COUNT, battery_millivolt);
        }
    }

    // Monotonicity enforcement: only allow percentage to move in the expected direction
    if (battery_percentage_ema != 0 && !charge_state_changed) {
        if (is_charging && raw_percentage < battery_percentage_ema) {
            raw_percentage = battery_percentage_ema;
        } else if (!is_charging && raw_percentage > battery_percentage_ema) {
            raw_percentage = battery_percentage_ema;
        }
    }

    // Global delta clamp: prevent large jumps even during EMA init or after reboot
    if (battery_percentage_ema != 0 || ema_init_counter > 0) {
        int16_t delta = (int16_t)raw_percentage - (int16_t)battery_percentage_ema;
        if (delta > MAX_BATTERY_DELTA_PER_TICK) {
            raw_percentage = battery_percentage_ema + MAX_BATTERY_DELTA_PER_TICK;
        } else if (delta < -MAX_BATTERY_DELTA_PER_TICK) {
            raw_percentage = (battery_percentage_ema > MAX_BATTERY_DELTA_PER_TICK)
                ? battery_percentage_ema - MAX_BATTERY_DELTA_PER_TICK : 0;
        }
    }

    // EMA initialization: seed the filter over FILTER_INIT_CYCLES before enabling smoothing
    if (!ema_initialized) {
        battery_percentage_ema = raw_percentage;
        ema_init_counter++;

        if (ema_init_counter >= FILTER_INIT_CYCLES) {
            ema_initialized = true;
            prev_is_charging = is_charging;
            LOG_INF("Battery EMA initialized at %d%%", battery_percentage_ema);
        }

        *battery_percentage = battery_percentage_ema;
    } else {
        battery_percentage_ema = update_ema_filter(battery_percentage_ema, raw_percentage);
        *battery_percentage = battery_percentage_ema;
    }

    return 0;
}

int battery_charge_start()
{
    return 0;
}

int battery_charge_stop()
{
    return 0;
}

int battery_set_fast_charge()
{
    return 0;
}

int battery_set_slow_charge()
{
    return 0;
}

int battery_charging_state_read()
{
    if (gpio_pin_get(bat_chg_pin.port, bat_chg_pin.pin) == 0) {
        is_charging = true;
    } else {
        is_charging = false;
    }
    return 0;
}

int battery_enable_read()
{
    int err;

    // Perform voltage divider configs
    err = gpio_pin_configure_dt(&bat_read_pin, GPIO_OUTPUT | NRF_GPIO_DRIVE_S0H1);
    if (err < 0) {
        LOG_ERR("Failed to configure bat_read_pin to output: %d", err);
        return err;
    }

    // Set pin low to enable battery voltage measurement path
    gpio_pin_set(bat_read_pin.port, bat_read_pin.pin, 0);
    k_msleep(10);

    if (!device_is_ready(adc_dev)) {
        LOG_ERR("ADC device %s is not ready", adc_dev->name);
        gpio_pin_configure_dt(&bat_read_pin, GPIO_INPUT); // Restore pin state
        return -ENODEV;
    }

    err = adc_channel_setup(adc_dev, &m_1st_channel_cfg);
    if (err) {
        LOG_ERR("ADC channel setup failed (error %d)", err);
        gpio_pin_configure_dt(&bat_read_pin, GPIO_INPUT); // Restore pin state
        return err;
    }

    // Trigger offset calibration with proper settling time
    NRF_SAADC_S->TASKS_CALIBRATEOFFSET = 1;
    k_msleep(5);

    // Read samples
    err = adc_read(adc_dev, &sequence);
    if (err) {
        LOG_WRN("ADC read failed (error %d)", err);
        gpio_pin_configure_dt(&bat_read_pin, GPIO_INPUT); // Restore pin state
        return err;
    }

    // Restore bat_read_pin
    err = gpio_pin_configure_dt(&bat_read_pin, GPIO_INPUT);
    if (err < 0) {
        LOG_ERR("Failed to configure bat_read_pin to input: %d", err);
        return err;
    }

    return 0;
}

int battery_init()
{
    int err;

    k_mutex_lock(&battery_mut, K_FOREVER);

    err = gpio_pin_configure_dt(&bat_read_pin, GPIO_INPUT);
    if (err < 0) {
        LOG_ERR("Failed to configure enable pin (%d)", err);
        k_mutex_unlock(&battery_mut);
        return err;
    }

    err = gpio_pin_configure_dt(&bat_chg_pin, GPIO_INPUT | GPIO_PULL_UP);
    if (err < 0) {
        LOG_ERR("Failed to configure enable pin (%d)", err);
        k_mutex_unlock(&battery_mut);
        return err;
    }
    battery_charging_callback(NULL, NULL, 0);
    err = gpio_pin_interrupt_configure_dt(&bat_chg_pin, GPIO_INT_EDGE_BOTH);
    if (err < 0) {
        LOG_ERR("Failed to configure interrupt for bat_chg_pin (%d)", err);
        k_mutex_unlock(&battery_mut);
        return err;
    }
    gpio_init_callback(&bat_chg_cb, battery_charging_callback, BIT(bat_chg_pin.pin));
    gpio_add_callback(bat_chg_pin.port, &bat_chg_cb);

    err = battery_enable_read();
    if (err < 0) {
        LOG_ERR("Failed to enable battery read (%d)", err);
        k_mutex_unlock(&battery_mut);
        return err;
    }

    k_mutex_unlock(&battery_mut);

    // Charging state read
    int chargingStateErr;
    chargingStateErr = battery_charging_state_read();
    if (chargingStateErr) {
        LOG_ERR("Failed to read charging state (%d)", chargingStateErr);
    }

    return 0;
}
```

## src/led.c
```c
#include "lib/core/led.h"

#include <zephyr/drivers/gpio.h>
#include <zephyr/logging/log.h>

#include "lib/core/settings.h"
#include "lib/core/utils.h"

LOG_MODULE_REGISTER(led, CONFIG_LOG_DEFAULT_LEVEL);

// Define LED GPIO specs from device tree
static const struct gpio_dt_spec led_red = GPIO_DT_SPEC_GET(DT_NODELABEL(led_red), gpios);
static const struct gpio_dt_spec led_green = GPIO_DT_SPEC_GET(DT_NODELABEL(led_green), gpios);
static const struct gpio_dt_spec led_blue = GPIO_DT_SPEC_GET(DT_NODELABEL(led_blue), gpios);

int led_start()
{
    ASSERT_TRUE(gpio_is_ready_dt(&led_red));
    ASSERT_TRUE(gpio_is_ready_dt(&led_green));
    ASSERT_TRUE(gpio_is_ready_dt(&led_blue));

    gpio_pin_configure_dt(&led_red, GPIO_OUTPUT_INACTIVE);
    gpio_pin_configure_dt(&led_green, GPIO_OUTPUT_INACTIVE);
    gpio_pin_configure_dt(&led_blue, GPIO_OUTPUT_INACTIVE);

    LOG_INF("LEDs (GPIO) started");
    return 0;
}

static void set_led_on_off(const struct gpio_dt_spec *led, bool on)
{
    if (!gpio_is_ready_dt(led)) {
        LOG_ERR("LED GPIO device not ready");
        return;
    }

    if (on) {
        uint8_t ratio = app_settings_get_dim_ratio();
        if (ratio < 10) {
            gpio_pin_set_dt(led, 0);
            return;
        }
    }

    gpio_pin_set_dt(led, on ? 1 : 0);
}

void set_led_red(bool on)
{
    set_led_on_off(&led_red, on);
}

void set_led_green(bool on)
{
    set_led_on_off(&led_green, on);
}

void set_led_blue(bool on)
{
    set_led_on_off(&led_blue, on);
}

void set_led_pwm(led_color_t color, uint8_t level)
{
    const struct gpio_dt_spec *led;

    switch (color) {
    case LED_RED:
        led = &led_red;
        break;
    case LED_GREEN:
        led = &led_green;
        break;
    case LED_BLUE:
        led = &led_blue;
        break;
    default:
        LOG_ERR("Invalid LED color");
        return;
    }

    if (!gpio_is_ready_dt(led)) {
        LOG_ERR("LED GPIO device not ready");
        return;
    }

    gpio_pin_set_dt(led, level > 0 ? 1 : 0);
}

void led_off(void)
{
    set_led_red(false);
    k_msleep(10);
    set_led_green(false);
    k_msleep(10);
    set_led_blue(false);
}
```
